/*
 * lcd5110.c
 *
 *  Created on: 2023年4月16日
 *      Author: hanyuan
 */

#include "lcd5110.h"
uint8_t g_line=0;
uint8_t g_x=0;
void LCD_WriteByte(uint8_t dc,uint8_t b)
{
	uint8_t i;
	SCE_H;
	SCE_L;
	if(dc) DC_H;
	else DC_L;
	for(i=0;i<8;i++)
	{
		//10101010
		SCLK_L;
		if(b&0x80)
		DIN_H;
		else DIN_L;
		SCLK_H;
		b=b<<1;
		//delay_us(50);
	}
	SCLK_L;
	DIN_L;
	SCE_H;
	//delay_us(100);
}

void LCD_Init(void)
{
	SCE_H;
	RST_L;
	HAL_Delay(10);
	RST_H;
	LCD_WriteByte(CMD,0x21);
  LCD_WriteByte(CMD,0xc8);
  LCD_WriteByte(CMD,0x06);
  LCD_WriteByte(CMD,0x13);
  LCD_WriteByte(CMD,0x20);
  LCD_Clean();
  LCD_WriteByte(CMD,0x0c);
	SCE_L;
}

void LCD_SetXY(uint8_t x,uint8_t y)
{
	g_x=x;g_line=y;
//	x=83-x;
//	y=5-y;
	x+=0x80;
	y+=0x40;

	LCD_WriteByte(CMD,x);
	LCD_WriteByte(CMD,y);
}

void LCD_Clean(void)
{
	uint16_t i=503;
	for(i=0;i<503;i++)
	{
		LCD_WriteByte(DAT,0x00);
	}
}

uint8_t GetFont(uint8_t dat)
{
	return dat-32;
}

uint8_t bin[]={1,2,4,8,16,32,64,128};
unsigned char Reverse(unsigned char x)
{
//	unsigned char t=0;
//	for(unsigned char i=0;i<8;i++)
//	{
//		t+=((x&0x80)?1:0)*bin[i];
//		x<<=1;
//	}
//	return t;
	return x;
}

void g_puts(uint8_t ch)
{
	uint8_t i,p=GetFont(ch);
	for(i=0;i<6;i++)
	{
		LCD_SetXY(g_x,g_line);
		LCD_WriteByte(DAT,Reverse(font6x8[p][i]));
		//LCD_WriteByte(DAT,font6x8[p][i]);
		g_x++;

	}
}

//write by userdefine-font
void u_puts(uint8_t* user_define_font)
{
	uint8_t i;
	for(i=0;i<6;i++)
	{
		LCD_SetXY(g_x,g_line);
		LCD_WriteByte(DAT,Reverse(user_define_font[i]));
		//LCD_WriteByte(DAT,font6x8[p][i]);
		g_x++;
	}
}

void g_print(char* dat)
{
	char* ptr=dat;
	while(*ptr!=0)
	{
		g_puts(*ptr);
		ptr++;
	}
}

void SetLine(uint8_t line)
{
	g_line=line;
//	LCD_SetXY(83,5-line);
	LCD_SetXY(0,line);
}

uint8_t line_ctl=0;

void GUI_SetLine(uint8_t line)
{
	line_ctl=line;
}

void f_print(char* dat)
{
	uint8_t cnt=0,length=strlen((const char*)dat);
	char buffer[14];
	memset(buffer,0,sizeof(buffer));
	if(length<=14)
	{
		memset(buffer,' ',sizeof(buffer));
		for(cnt=0;cnt<length;cnt++)
			buffer[cnt]=dat[cnt];
		l_print(buffer,line_ctl,Left);
		if(line_ctl==5)
			line_ctl=0;
		else
			line_ctl++;
	}
	else
	{
		while(length-cnt>14)
		{
			memcpy(buffer,dat+cnt,14);
			l_print((char*)&"              ",line_ctl,Left);
			l_print(buffer,line_ctl,Left);
			if(line_ctl==5)
				line_ctl=0;
			else
				line_ctl++;
			memset(buffer,0,sizeof(buffer));
			cnt+=14;
		}
		memcpy(buffer,dat+cnt,length-cnt);
		uint8_t t_buffer[14];
		memset(t_buffer,' ',sizeof(t_buffer));
		for(cnt=0;cnt<length;cnt++)
		{
			if(buffer[cnt])
				t_buffer[cnt]=buffer[cnt];
		}
		l_print((char*)t_buffer,line_ctl,Left);
		if(line_ctl==5)
				line_ctl=0;
		else
			line_ctl++;
	}
}

void l_print(const char* dat,uint8_t line,enum StrLocation loc)
{
	//14 chars
	uint8_t length=strlen((const char*)dat),i;
	if(loc!=Right){
		if(loc==Middle)
		{
			SetLine(line);
			for(i=0;i<(14-length)/2;i++) g_puts(' ');
		}
		else if(loc==Left) SetLine(line);
		g_print(dat);
	}
	else{
		//char temp[15]="              ";
		//uint8_t start=14-length;
		//for(i=0;i<length;i++){
		//	temp[start+i]=dat[i];
		//}
		//SetLine(line);
		//g_print(temp);
		LCD_SetXY((14-length)*6,line);
		g_print(dat);
	}
}

//x: 0~13 y:0~5
void LCD_draw_big(uint8_t x,uint8_t y,uint8_t which){
	//(x,y)   (x+1,y)
	//(x,y+1) (x+1,y+1)
	uint8_t i;
	for(i=0;i<12;i++)
	{
		LCD_SetXY(x*6+i,y);
		LCD_WriteByte(DAT,Reverse(font_big[which][2*i]));
	}
	for(i=0;i<12;i++)
	{
		LCD_SetXY(x*6+i,y+1);
		LCD_WriteByte(DAT,Reverse(font_big[which][2*i+1]));
	}
}

void LCD_draw_big_num(uint8_t x,uint8_t y,uint8_t which){
	//(x,y)   (x+1,y)
	//(x,y+1) (x+1,y+1)
	uint8_t i;
	for(i=0;i<12;i++)
	{
		LCD_SetXY(x*6+i,y);
		LCD_WriteByte(DAT,Reverse(font_big_number[which][2*i]));
	}
	for(i=0;i<12;i++)
	{
		LCD_SetXY(x*6+i,y+1);
		LCD_WriteByte(DAT,Reverse(font_big_number[which][2*i+1]));
	}
}

void LCD_draw_freertos(uint8_t x,uint8_t y){
	//(x,y)   (x+1,y)
	//(x,y+1) (x+1,y+1)
	for(uint8_t which=0;which<8;which++){
		uint8_t i;
		for(i=0;i<12;i++)
		{
			LCD_SetXY(x*6+i,y);
			LCD_WriteByte(DAT,Reverse(font_freertos[which][2*i]));
		}
		for(i=0;i<12;i++)
		{
			LCD_SetXY(x*6+i,y+1);
			LCD_WriteByte(DAT,Reverse(font_freertos[which][2*i+1]));
		}
		x++;
	}
}

const uint8_t font6x8[][6] =
{
    { 0x00, 0x00, 0x00, 0x00, 0x00, 0x00 },   // sp
    { 0x00, 0x00, 0x00, 0x2f, 0x00, 0x00 },   // !
    { 0x00, 0x00, 0x07, 0x00, 0x07, 0x00 },   // "
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    {96,0,120,0,126,0},    // SIGNAL-3 97
};

//const uint8_t font_big[][24]={
//            {0x00, 0x00, 0x00, 0x00, 0xF8, 0x1F, 0x88, 0x08, 0xF8, 0x1F, 0x10, 0x00, 0x90, 0x07, 0x10, 0x24,
//                0xFC, 0x3F, 0x10, 0x00, 0x10, 0x00, 0x00, 0x00},/*"时",0*/
//            {0x00, 0x00, 0x00, 0x00, 0x44, 0x30, 0xD8, 0x1F, 0x00, 0x28, 0xE8, 0x24, 0xA8, 0x22, 0xFC, 0x3F,
//                0xA8, 0x22, 0xE8, 0x2C, 0x00, 0x20, 0x00, 0x00},/*"速",1*/
//            {0x00, 0x00, 0x00, 0x00, 0x00, 0x00, 0xC0, 0x30, 0x00, 0x00, 0x00, 0x00, 0x00, 0x00, 0x00, 0x00,
//                0x00, 0x00, 0x00, 0x00, 0x00, 0x00},/*"：",2*/
//            {0x00, 0x00, 0x00, 0x00, 0x00, 0x10, 0xF8, 0x15, 0x48, 0x15, 0xF8, 0x1F, 0x48, 0x15, 0x48, 0x15,
//                0xF8, 0x15, 0x00, 0x10, 0x00, 0x00, 0x00, 0x00},/*"里",0*/
//            {0x00, 0x00, 0x00, 0x00, 0x50, 0x06, 0xF0, 0x1F, 0x48, 0x03, 0x30, 0x11, 0x48, 0x15, 0x48, 0x1F,
//                0x78, 0x15, 0x00, 0x10, 0x00, 0x00, 0x00, 0x00},/*"程",1*/
//};

const uint8_t font_big[][24]={
		{0xF8,0x1F,0x88,0x08,0x88,0x08,0xF8,0x1F,0x40,0x00,0x50,0x05,0x50,0x29,0x7C,0x21,
		0xD0,0x3F,0x50,0x01,0x40,0x01,0x00,0x00},/*"時",0*/

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		{0xF8,0x27,0xA8,0x14,0xA8,0x04,0xA8,0x14,0xF8,0x27,0x80,0x00,0x40,0x20,0xBC,0x17,
		0x20,0x08,0xE0,0x17,0x20,0x20,0x00,0x00},/*"敗",16*/
};

const uint8_t font_big_number[][24]={
		{0x00, 0x00, 0xC0, 0x07, 0xF0, 0x1F, 0xF0, 0x1F, 0xF8, 0x3F, 0x18, 0x30, 0x08, 0x20, 0x18, 0x30
            , 0xF8, 0x3F, 0xF0, 0x1F, 0xF0, 0x1F, 0xC0, 0x07},/*"0",0*/

        {0x00, 0x00, 0x00, 0x00, 0x60, 0x00, 0x20, 0x00, 0x30, 0x00, 0xF0, 0x3F, 0xF8, 0x3F, 0xF8, 0x3F,
            0xF8, 0x3F, 0x00, 0x00, 0x00, 0x00, 0x00, 0x00},/*"1",1*/

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        {0x00, 0x00, 0xE0, 0x18, 0xF0, 0x39, 0xF8, 0x23, 0xF8, 0x23, 0x08, 0x22, 0x08, 0x32, 0xF8, 0x3F,
            0xF0, 0x1F, 0xF0, 0x0F, 0xC0, 0x07, 0x00, 0x00},/*"9",1*/

};

const uint8_t font_freertos[][24]={

		{0x00,0x00,0xF0,0x1F,0xF0,0x1F,0x10,0x01,0x10,0x01,0x10,0x01,0x10,0x00,0x00,0x00},/*"F",0*/

		{0x00,0x00,0xC0,0x1F,0xC0,0x1F,0x00,0x01,0x80,0x00,0xC0,0x00,0xC0,0x00,0x00,0x00},/*"r",1*/
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		{0x00,0x00,0x60,0x08,0xF0,0x18,0x90,0x11,0x10,0x13,0x30,0x1E,0x20,0x0C,0x00,0x00},/*"S",7*/
};

